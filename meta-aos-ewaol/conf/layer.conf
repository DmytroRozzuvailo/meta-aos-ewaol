## meta-aos-ewaol/conf/layer.conf
```bitbake
# We have a conf and classes directory, add to BBPATH
BBPATH .= ":${LAYERDIR}"

# We have recipes-* directories, add to BBFILES
BBFILES += "${LAYERDIR}/recipes-*/*/*.bb \
            ${LAYERDIR}/recipes-*/*/*.bbappend"

BBFILE_COLLECTIONS += "meta-aos-ewaol"
BBFILE_PATTERN_meta-aos-ewaol = "^${LAYERDIR}/"
BBFILE_PRIORITY_meta-aos-ewaol = "9"

LAYERSERIES_COMPAT_meta-aos-ewaol = "kirkstone"

DISTRO_FEATURES:append = " systemd "

# enable EFI
DISTRO_FEATURES:append = " efi"

EWAOL_AOS_GRUB_CONFIG := "${LAYERDIR}/wic/grub.cfg"
```

## meta-aos-ewaol/conf/machine/ewaol-aos-qemuarm64.conf
```bitbake
MACHINEOVERRIDES =. "qemuarm64:"

require ${COREBASE}/meta/conf/machine/qemuarm64.conf

KMACHINE = "qemuarm64"

UBOOT_MACHINE = "qemu_arm64_defconfig"

QB_MACHINE = "-machine virt,secure=off"
QB_OPT_APPEND += "-no-acpi"
QB_MEM = "-m 2048"
QB_DEFAULT_FSTYPE = "wic"
QB_DEFAULT_BIOS = "flash.bin"
QB_FSINFO = "wic:no-kernel-in-fs"
QB_ROOTFS_OPT = ""

# kernel is in the image, should not be loaded separately
QB_DEFAULT_KERNEL = "none"

KERNEL_IMAGETYPE = "Image"
PREFERRED_PROVIDER_virtual/kernel = "linux-yocto"
PREFERRED_VERSION_linux-yocto = "5.15%"

IMAGE_FSTYPES = "ext4 wic wic.vmdk"

INITRAMFS_IMAGE = "core-image-minimal-initramfs"
WKS_FILE_DEPENDS += "core-image-minimal-initramfs"
do_image_wic[depends] += "core-image-minimal-initramfs:do_image_complete"
WKS_FILE = "ewaol-aos.wks.in"
IMAGE_BOOT_FILES = "${KERNEL_IMAGETYPE}"
```
